## CMakeLists.txt
```
# octomancer-sync, built as firmware for an nRF52840 dongle.
#
# Almost every file listed here is the same file the Mac builds. That is the
# point of the seam described in CLAUDE.md and in src/syncd.h: the
# decision-making is kept free of any radio, so it can be tested on a machine
# with no hardware -- and the same property is what lets it be compiled for a
# device with no operating system. Only the four files under firmware/src are
# new, and all four are glue: a loop backend, a radio, a serial port, and a
# main() to tie them together.
#
# What is deliberately absent: src/loop_posix.cc, src/server.cc, src/boxsock.cc
# and everything else that assumes a file descriptor. The Zephyr backend in
# firmware/src/loop_zephyr.cc replaces the first, and firmware/src/cdcpeer.cc
# replaces the rest.
cmake_minimum_required(VERSION 3.20.0)

find_package(Zephyr REQUIRED HINTS $ENV{ZEPHYR_BASE})
project(octomancer_sync LANGUAGES C CXX)

set(OCTO ${CMAKE_CURRENT_SOURCE_DIR}/../src)

target_include_directories(app PRIVATE ${OCTO} ${CMAKE_CURRENT_SOURCE_DIR}/src)

# src/timeutil.cc calls localtime_r, which is the reentrant form and the only
# one that is safe to call at all. Picolibc declares it only when POSIX is
# visible, and Zephyr compiles C++ as strict ISO -- CONFIG_STD_CPP20 means
# -std=c++20, not -std=gnu++20 -- which defines __STRICT_ANSI__ and hides it.
# The implementation is there either way (CONFIG_POSIX_C_LANG_SUPPORT_R); this
# is only about the declaration. Asking for POSIX explicitly is the fix that
# does not require editing a portable file for one target's feature macros.
target_compile_definitions(app PRIVATE _POSIX_C_SOURCE=200809L)

# The glue, which exists only on this target.
target_sources(app PRIVATE
  src/main.cc
  src/blepeer.cc
  src/boxadmin.cc
  src/boxclock.cc
  src/cdcpeer.cc
  src/faultlog.cc
  src/hwwatchdog.cc
  src/loop_zephyr.cc
  src/scanner_zephyr.cc
)

# The program. Every one of these is compiled unchanged for the Mac as well,
# and is covered by `make check` there.
target_sources(app PRIVATE
  ${OCTO}/advert.cc
  ${OCTO}/bmd.cc
  ${OCTO}/boxmsg.cc
  ${OCTO}/camconf.cc
  ${OCTO}/camsync.cc
  ${OCTO}/escape.cc
  ${OCTO}/hci.cc
  ${OCTO}/loop.cc
  ${OCTO}/naming.cc
  ${OCTO}/registry.cc
  ${OCTO}/syncd.cc
  ${OCTO}/tentacle.cc
  ${OCTO}/timeutil.cc
  ${OCTO}/watchdog.cc
)
```

## prj.conf
```kconfig
# octomancer-sync as firmware. See firmware/CMakeLists.txt for what is built.

# --- C++ ---------------------------------------------------------------
#
# The program is ordinary C++ using std::string, std::vector and
# std::function, so it needs a real standard library rather than the minimal
# one. What it does not need is threads, and it could not have them anyway:
# src/loop.h records that this SDK's libstdc++ is built without
# _GLIBCXX_HAS_GTHREADS in every multilib variant, so std::thread and
# std::mutex do not exist on this target at all. That measurement is why the
# whole core is single-threaded.
CONFIG_CPP=y
CONFIG_STD_CPP20=y
CONFIG_GLIBCXX_LIBCPP=y
CONFIG_CPP_EXCEPTIONS=y
CONFIG_REQUIRES_FULL_LIBC=y

# Picolibc ships printf in two flavours and links the integer-only one unless
# asked. The integer-only one does not fail on "%f" -- it prints nothing for
# it, and returns success. So src/boxmsg.cc's set_double produced `offset=`
# with no number after it, for every offset, spread, uptime and drift figure
# this box has, while set_int worked and the build was clean and silent.
#
# The whole protocol is doubles. src/boxmsg.h's can_format_doubles() is run at
# boot and reported over the wire, so that this line going missing again is
# something the box says out loud rather than something a host has to infer
# from a conversation that has gone strange.
CONFIG_PICOLIBC_IO_FLOAT=y

# The roster and the message layer both allocate. 96 KB leaves room for the
# Bluetooth stack and still holds a bench of boxes with their sample windows;
# see kBoxMaxSamples in firmware/src/main.cc for the arithmetic.
CONFIG_COMMON_LIBC_MALLOC_ARENA_SIZE=98304
# 16 KB, and the reason is worth writing down because eight was a considered
# number that turned out to be wrong for a reason nothing in this code makes
# visible.
#
# The whole box runs on this one stack: the loop, every callback it dispatches,
# the daemon underneath that, and the C library underneath that. Parsing a
# double is the deepest point -- picolibc's exact conversion uses the Ryu
# algorithm, which is generous with stack -- so a `time` message from a host
# was enough to push a chain that was already several frames deep past the end.
#
# It presented as a fault inside __double_computeInvPow5, which is the victim
# rather than the culprit: the MPU guard caught the function's own prologue
# pushing registers off the end. See firmware/src/faultlog.cc, which now names
# that case rather than reporting it as "unknown".
CONFIG_MAIN_STACK_SIZE=16384
CONFIG_HEAP_MEM_POOL_SIZE=2048

# k_poll is the loop's wait -- firmware/src/loop_zephyr.cc.
CONFIG_POLL=y

# src/timeutil.cc uses localtime_r, which is the reentrant form and the only
# one that is safe to call at all. Picolibc has it behind this option.
CONFIG_POSIX_C_LANG_SUPPORT_R=y

# CONFIG_XSI_SINGLE_PROCESS is deliberately NOT set here, though it would make
# the build link. It supplies a gettimeofday backed by a system clock nothing
# on this device ever sets, so src/timeutil.cc's wall_now() would compile,
# link, and answer 1970 for the life of the program. firmware/src/boxclock.cc
# defines that symbol instead, from the clock the host actually gave us.

# --- the radio ---------------------------------------------------------
CONFIG_BT=y
CONFIG_BT_OBSERVER=y
CONFIG_BT_DEVICE_NAME="octomancer"

# The box protocol over the air as well as down the cable, so that a dongle in
# a phone charger is a usable member of the system rather than something that
# has to stay tethered to a laptop. firmware/src/blepeer.h is the transport;
# src/syncd.h already keeps a list of peers, so this is simply another one and
# nothing on the box has to decide which is in charge.
#
# Observer and peripheral at once. The controller interleaves them, so
# advertising and holding a connection do cost scan time -- a box being talked
# to hears slightly fewer advertisements than one that is not. That is the
# right trade: the alternative is a box nobody can reach.
CONFIG_BT_PERIPHERAL=y
# Two connections, and only one of them is a host.
#
# One is the central that has come to talk to this box. The other is left for
# the camera, which this box will connect *out* to when it has a central role
# to do it with -- that is the next piece, and it is not here yet.
#
# Setting this to one today would work perfectly and then fail in a way that
# would take an evening to find: a camera sync that succeeded whenever nobody
# was connected over Bluetooth and failed silently whenever somebody was. The
# spare slot costs a little RAM now and no confusion later.
CONFIG_BT_MAX_CONN=2

# A bigger ATT MTU, so a device list is a handful of notifications rather than
# fifty. The default 23 leaves twenty bytes of payload, and a `dev` line is
# well over a hundred. blepeer.cc splits either way -- a notification is not a
# message boundary -- but splitting into twenty-byte pieces at one packet per
# connection interval is slow enough to notice.
CONFIG_BT_L2CAP_TX_MTU=247
CONFIG_BT_BUF_ACL_TX_SIZE=251
CONFIG_BT_BUF_ACL_RX_SIZE=251
CONFIG_BT_CTLR_DATA_LENGTH_MAX=251

# --- the wire ----------------------------------------------------------
#
# One CDC ACM port, carrying the box protocol and nothing else. The console is
# switched off rather than left alone: this board points its console at the
# same port, and Zephyr's boot banner alone would put "*** Booting Zephyr OS
# ***" in front of the greeting. Two writers on one wire is a protocol that
# cannot be parsed.
CONFIG_CONSOLE=n
CONFIG_UART_CONSOLE=n
CONFIG_BOOT_BANNER=n
CONFIG_PRINTK=n
CONFIG_LOG=n

CONFIG_SERIAL=y
CONFIG_UART_INTERRUPT_DRIVEN=y
# DTR is the only evidence a serial port offers that a host is there, and
# firmware/src/cdcpeer.cc uses it as the peer's open and close.
CONFIG_UART_LINE_CTRL=y

# CONFIG_USBD_CDC_ACM_WORKQUEUE is deliberately NOT set, and the reasoning is
# worth keeping because it is a good argument that lost to evidence.
#
# The driver calls our "interrupt" handler from a workqueue rather than from an
# interrupt, and by default that is the *system* workqueue -- which is also
# where the USB stack answers control transfers. So anything stuck in
# cdcpeer.cc's isr() stops the device answering SET_CONTROL_LINE_STATE, and a
# host trying to open the port hangs forever against a dongle that still
# enumerates and still blinks. The driver offers a private queue for exactly
# that, and taking it looked obviously right.
#
# Then the image that took it never enumerated at all. Not a wedge -- absent
# from the bus, no flicker, nothing. The dedicated queue is the only thing in
# that image which runs before USB comes up: it starts a cooperative-priority
# thread from a POST_KERNEL SYS_INIT, and the USB device itself is brought up
# later, at APPLICATION. Everything else that changed runs after enumeration or
# only on a fault.
#
# That is an inference from init ordering and a config diff, not a proof -- the
# board cannot be instrumented while it is failing to enumerate, which is the
# whole difficulty. It is recorded as the suspect rather than the cause. What
# makes it safe to simply drop is that the reason for wanting it is now covered
# better: the watchdog below catches a starved workqueue and says so, which is
# more than this ever did.

# So that this dongle says what it is. Every Zephyr application on this board
# is called "CDC ACM serial backend" by default -- it is the board's generic
# name for its USB serial port, not any sample's -- and that is genuinely
# misleading: it is the string that made a running hci_uart look like a stock
# CDC sample for a day. A dongle running this firmware now says so.
CONFIG_CDC_ACM_SERIAL_PRODUCT_STRING="octomancer-sync"
CONFIG_CDC_ACM_SERIAL_MANUFACTURER_STRING="octomancer"

# A sign of life, since there is no console to print one on.
CONFIG_GPIO=y

# So the box can be asked to reboot into its bootloader -- see
# firmware/src/boxadmin.h. Without this, replacing this image means holding a
# button while plugging the dongle in, which is per-board and easy to get
# wrong; doc/dongle-notes.md records a day lost to exactly that.
CONFIG_REBOOT=y

# --- the watchdog ------------------------------------------------------
#
# The last line of defence, and the only one that covers a box which has not
# crashed but has stopped. firmware/src/faultlog.cc catches a fault and
# reboots, but a workqueue that cannot run is not a fault: nothing throws,
# nothing faults, and the machine sits there enumerated and blinking with a
# port that will not open. Only a watchdog catches that.
#
# Once started it cannot be stopped or reconfigured until the chip resets, so
# see firmware/src/hwwatchdog.h before changing anything here.
CONFIG_WATCHDOG=y

# So the next boot can find out it was the watchdog that ended the last one.
# The reset cause is the only record there is: a watchdog reset leaves nothing
# behind of its own, because nothing is running at the moment it happens.
CONFIG_HWINFO=y
```

## src/main.cc
```c
// octomancer-sync, as firmware.
//
// The fourth host for src/syncd.h and the one it was shaped for. That header
// says the same object "runs as a process on this Mac and as firmware on the
// Nordic", and this file is the second half of that claim: it constructs a
// loop, a roster, a radio and a pipe, hands them to a SyncDaemon, and runs.
// Every decision about what to do with a Tentacle reading is in code that
// `make check` already exercised on a machine with no radio in it.
//
// What is different about this host, and only this host:
//
//   * There is no filesystem, so there is no cameras.conf and no camera
//     database. set_config(nullptr) is a supported state -- see
//     src/camconf.h's default, which is the same one.
//   * There is no wall clock. firmware/src/boxclock.h holds what the host
//     told us, and until it does, offsets are not computed against anything.
//   * There is no console. The CDC port carries the box protocol and nothing
//     else, so the daemon's chatter goes out as `say` messages on the same
//     wire -- which is what src/boxmsg.h means by "a terminal and a cable
//     should be enough to see what the box is doing".
//   * There is no camera client yet, so set_camera is never called. A daemon
//     with no camera "still hears boxes, still serves the roster, and still
//     says why it is not syncing anything" -- src/syncd.h. That is exactly
//     what this is for now, and doc/box-notes.md records what is missing.
#include <zephyr/bluetooth/bluetooth.h>
#include <zephyr/device.h>
#include <zephyr/devicetree.h>
#include <zephyr/drivers/gpio.h>
#include <zephyr/kernel.h>

#include <memory>
#include <string>
#include <vector>

#include "boxadmin.h"
#include "faultlog.h"
#include "hwwatchdog.h"
#include "boxclock.h"
#include "boxmsg.h"
#include "blepeer.h"
#include "cdcpeer.h"
#include "loop.h"
#include "registry.h"
#include "naming.h"
#include "scanner_zephyr.h"
#include "syncd.h"
#include "watchdog.h"

namespace {

// The port. The board points its console, its shell and its HCI-to-host UART
// at this same node; this firmware points nothing at it but the box protocol,
// because two writers on one wire is a protocol that cannot be parsed.
const struct device* cdc_uart() {
  return DEVICE_DT_GET(DT_NODELABEL(board_cdc_acm_uart));
}

// A sign of life, because there is no console to print one on. Slow while
// nobody is attached, quick once a host is: the two questions a person
// standing over the dongle actually has are "is it running" and "did the Mac
// find it".
const struct gpio_dt_spec g_led = GPIO_DT_SPEC_GET_OR(DT_ALIAS(led0), gpios, {});

// The roster, sized for 256 KB of RAM rather than for a Mac.
//
// A Sample is sixteen bytes and the default cap is 8192 of them, which is 128
// KB for one device -- more memory than this whole machine has, for one box on
// a bench that usually has five. The host keeps the long history; this keeps
// enough to answer what the offset is now.
//
// The visible cost is drift: src/registry.h will not report ppm from an arm
// shorter than min_drift_span, and 240 samples of a box advertising about once
// a second is nothing like fifteen minutes. So the box reports offsets and the
// Mac reports drift, which is the division doc/box-notes.md already draws --
// "the storage limitations are on octomancer-sync".
constexpr size_t kBoxMaxSamples = 240;
constexpr double kBoxWindow = 900.0;

// The watchdog, in seconds. Generous on purpose: it is here to catch a machine
// that has stopped, not to police latency, and the two mistakes are not equally
// bad. A reset that fires on a working dongle takes the radio off the air in
// the middle of somebody's shoot; one that fires ten seconds late clears a
// wedge that would otherwise have lasted until a person noticed. See
// firmware/src/hwwatchdog.h for why this cannot be adjusted afterwards.
constexpr double kWatchdogTimeout = 12.0;

// How often the USB side is asked to prove it can still run, and how long it
// may take to answer. The patience is well under the watchdog's own timeout so
// that a stuck wire is reported as a stuck wire rather than arriving at the
// same moment as the reset.
// How long the box spends being nothing but a serial port before it tries
// anything that might not survive. Long enough for USB enumeration to finish
// and for a host that is already watching to open the port; short enough that
// nobody waiting on a dongle notices.
constexpr double kQuietStart = 2.0;

constexpr double kWireProbePeriod = 3.0;
constexpr double kWirePatience = 4.0;

}  // namespace

int main() {
  auto loop = octo::make_loop();
  octo::BoxClock clock(loop.get());
  // So that wall_now() and std::chrono agree with it -- see the header.
  octo::install_box_clock(&clock);

  octo::Policy policy;
  policy.max_samples = kBoxMaxSamples;
  policy.window = kBoxWindow;
  octo::Registry registry(policy, loop->now());

  octo::SyncdOptions opt;
  // No camera client on this side yet, so there is nothing to hold open and
  // nothing to permit. Both are stated rather than left at a default, because
  // both become live decisions the moment the camera half lands.
  opt.hold = false;
  opt.default_writes = false;

  octo::SyncDaemon daemon(loop.get(), &registry, opt);
  daemon.set_wall_clock([&clock]() { return clock.wall(); });

  octo::CdcPeer peer(loop.get(), cdc_uart());
  // The same protocol over the air. Started later -- it needs the controller
  // up -- but constructed here so that everything with the program's lifetime
  // is in one place.
  octo::BlePeer air(loop.get());

  // Console chatter, onto the only wire there is. Never load-bearing -- a
  // client is free to ignore every `say` line -- but it is the difference
  // between watching the box work and guessing.
  daemon.on_say([&peer](const std::string& text) {
    octo::Message msg;
    msg.verb = "say";
    msg.set("text", text);
    peer.send(octo::encode(msg));
  });

  // The host telling us what time it is. Until this arrives the roster holds
  // readings with no offset against them, which is the honest state -- see
  // firmware/src/boxclock.h.
  daemon.on_settime([&clock](const octo::SyncDaemon::WallTime& t) {
    // Zone first. set() is what makes the clock known, and the registry starts
    // taking offsets the instant it is -- so adopting the instant before the
    // zone leaves a window whose readings are wrong by the whole offset.
    if (t.has_zone) clock.set_zone(t.zone);
    clock.set(t.wall);
  });

  // What this run needs to tell the first person who asks.
  //
  // A box with no console can only report a problem to somebody who is
  // listening, and the first host to open the port is the first opportunity
  // there has ever been -- possibly days after the thing being reported. So
  // these are gathered at boot and kept, rather than announced into a void.
  std::vector<std::string> boot_notes;

  // Why the last run ended. Empty when it ended cleanly, which is most of the
  // time and is worth staying quiet about.
  const std::string fault_line = octo::describe_fault(octo::take_last_fault());
  if (!fault_line.empty()) boot_notes.push_back(fault_line);

  // Safe mode: come up as a port and nothing else, when the last attempt did
  // not last.
  //
  // This is the answer to the problem that made the first evenings expensive.
  // A box that dies during startup cannot be asked anything -- it is not up
  // long enough to be asked -- so the only evidence is its absence, and every
  // theory about it costs somebody a trip to the desk with a paperclip. USB
  // comes up before main() does, though, which means a box that skips
  // everything risky can be a perfectly good port with a story to tell.
  //
  // So the second attempt in a row does exactly that: no radio, no scanner, no
  // cycle, no watchdog. Whatever killed the last run is not run again, and the
  // fault record from it is sitting in the greeting.
  const bool safe_mode = octo::boot_attempts() > 1;
  if (safe_mode) {
    boot_notes.push_back(
        "safe mode: the radio and the sync cycle are switched off because the"
        " last start did not last. Nothing here has run the code that failed."
        " Reflash, or power-cycle to try a normal start.");
  }

  // Whether this build can print the numbers the protocol is made of. The
  // failure it catches is silent from both ends: every number in every message
  // comes out empty and nothing reports an error. Saying so is the difference
  // between one line and another evening.
  if (!octo::can_format_doubles()) {
    boot_notes.push_back(
        "this build cannot format floating point -- every number in this"
        " protocol will be empty (CONFIG_PICOLIBC_IO_FLOAT)");
  }

  peer.on_open([&daemon, &peer, &boot_notes]() {
    daemon.peer_opened(&peer);
    for (const std::string& note : boot_notes) {
      octo::Message msg;
      msg.verb = "say";
      msg.set("text", note);
      peer.send(octo::encode(msg));
    }
  });
  peer.on_close([&daemon, &peer]() { daemon.peer_closed(&peer); });
  peer.on_line([&daemon, &peer](const std::string& line) {
    // Two verbs mean something only on a box -- see firmware/src/boxadmin.h.
    // Everything else, including every malformed line, is the daemon's.
    octo::PeerStats stats;
    stats.dropped_tx = peer.dropped_tx();
    stats.dropped_rx = peer.dropped_rx();
    stats.long_lines = peer.long_lines();
    if (handle_box_admin(line, &peer, stats)) return;
    daemon.peer_line(&peer, line);
  });

  // ...and exactly the same over Bluetooth. Nothing here decides which link is
  // in charge, and nothing here should: src/syncd.h keeps a list of peers and
  // announces to all of them, so a box with a cable and a radio link simply
  // has two. Whether to use the radio at all is a question only the host can
  // answer, because only the host knows whether it also has the cable -- see
  // want_bluetooth() in src/dongle.h.
  air.on_open([&daemon, &air]() { daemon.peer_opened(&air); });
  air.on_close([&daemon, &air]() { daemon.peer_closed(&air); });
  air.on_line([&daemon, &air](const std::string& line) {
    octo::PeerStats stats;
    stats.dropped_tx = air.dropped_tx();
    stats.dropped_rx = air.dropped_rx();
    stats.long_lines = air.long_lines();
    if (handle_box_admin(line, &air, stats)) return;
    daemon.peer_line(&air, line);
  });

  std::string err;
  if (!peer.start(&err)) {
    // Nothing can be reported: the thing that failed is the only way to
    // report anything. The LED is the whole diagnostic, so make it say
    // something distinct rather than pretending to run.
    if (g_led.port != nullptr) gpio_pin_configure_dt(&g_led, GPIO_OUTPUT_ACTIVE);
    return 1;
  }

  // Say something to whoever is attached right now, and keep it for whoever
  // attaches later. Both, because the interesting failures happen before a
  // person has got round to plugging the cable in.
  auto say_now = [&peer](const std::string& text) {
    octo::Message msg;
    msg.verb = "say";
    msg.set("text", text);
    peer.send(octo::encode(msg));
  };

  // Two checks, because there are two things that can stop separately. The
  // loop going round is the obvious one. The other is the USB side, which
  // Zephyr's CDC ACM runs on a workqueue rather than in an interrupt, and
  // which can therefore wedge while the loop is perfectly healthy -- a dongle
  // that still enumerates, still blinks, and will not open.
  octo::WatchdogPolicy guard;
  octo::ProbeLiveness wire(kWireProbePeriod, kWirePatience);
  // The loop's own check is a constant. That is not a tautology: it runs from
  // a loop timer, so the check being *called at all* is the evidence, and a
  // loop that has stopped stops feeding whatever it returns.
  guard.watch("loop", []() { return true; });
  guard.watch("wire", [&wire, &peer, &loop]() {
    bool poke = false;
    const bool ok = wire.poll(loop->now(), peer.wire_ticks(), &poke);
    if (poke) peer.probe_wire();
    return ok;
  });

  // ---------------------------------------------------------------------
  // Everything past this point is deferred, and the ordering is the point.
  //
  // Be reachable first. A box with no console can only explain itself to a
  // host that has managed to open its port, so the one thing worth doing
  // before anything else is becoming a port -- and then, only once the loop is
  // running and a host could be talking to it, doing the work that might not
  // survive. Radio, scanner, cycle, watchdog and even the self-check are all
  // work that might not survive.
  //
  // Done in the obvious order this cost two evenings: an image that faults
  // while bringing the radio up never enumerates properly, so it cannot say
  // that is what it was doing, and from the far end it is indistinguishable
  // from a dead cable. A couple of seconds of being nothing but a serial port
  // is the difference between a box that fails and a box that fails *and says
  // so*.
  // ---------------------------------------------------------------------
  std::unique_ptr<octo::Scanner> scanner;

  loop->after(kQuietStart, [&]() {
    // The self-check first, because it is the cheapest and its failure mode is
    // the most confusing: every number in every message silently empty.
    if (!octo::can_format_doubles()) {
      boot_notes.push_back(
          "this build cannot format floating point -- every number in this"
          " protocol will be empty (CONFIG_PICOLIBC_IO_FLOAT)");
      say_now(boot_notes.back());
    }

    if (safe_mode) {
      daemon.set_radio_state("off");
      return;
    }

    // The controller, brought up here rather than in the scanner because the
    // camera client will want the same one. A radio switched on twice is a
    // radio nobody owns.
    const int rc = bt_enable(nullptr);
    if (rc != 0) {
      daemon.set_radio_state("unsupported");
      say_now("the radio would not start");
    } else {
      std::string radio_err;
      scanner = octo::make_zephyr_scanner(
          loop.get(), &clock,
          [&daemon](const octo::Advert& a) { daemon.observe_advert(a); },
          [&daemon](const octo::Sighting& s) { daemon.observe_camera(s); },
          [&daemon](const std::string& state) { daemon.set_radio_state(state); });
      // Reachable over the air as well, now that there is a controller. After
      // the scanner rather than before it: listening is this box's job and
      // being talked to is a convenience, so if only one of them can be had,
      // it should be the listening.
      std::string air_err;
      if (!air.start(&air_err)) {
        say_now("the radio would not advertise -- this box is reachable only"
                " over USB");
      }
      if (!scanner->start(&radio_err)) {
        // start() has already reported the state through the handler above, so
        // the roster says "poweredOff" rather than staying "unknown" -- which
        // is the distinction octomancerd needs to tell a broken radio from one
        // that has not answered yet.
      }
    }

    daemon.start();
    // Only a run that actually tried the job may declare itself a success. A
    // safe-mode run staying up proves nothing about the code it skipped, and
    // letting it clear the count would hide a box that cannot start normally.
    octo::arm_settle_timer();

    std::string wdt_err;
    if (!octo::start_watchdog(loop.get(), &guard, kWatchdogTimeout, &wdt_err)) {
      // Not fatal. A dongle with no watchdog still does its job; it just
      // cannot get itself out of a wedge, which is the state it was in before
      // there was one at all. Said out loud rather than silently accepted.
      boot_notes.push_back("no watchdog: " + wdt_err);
      say_now(boot_notes.back());
    }
  });

  // Ask the room what it is called, while anything in it is unnamed.
  //
  // A Tentacle keeps its clock in the advertisement and its name in the scan
  // response, so a passive radio -- which is what this was, always -- knows
  // the time exactly and cannot name a single box. Every device this dongle
  // reported was listed by its hardware address for that reason.
  //
  // Checked on a slow timer rather than per advertisement: the decision is
  // damped anyway (src/naming.h) and building a snapshot is the expensive
  // part of asking.
  //
  // Outside the LED block, which is where this was written by accident. A
  // board with no LED in its devicetree would have skipped the naming timer
  // along with the flashing and reported every box by its hardware address
  // forever, for want of an indicator nobody was looking at.
  octo::Loop* const lp = loop.get();
  loop->every(5.0, [&registry, &scanner, lp, &clock]() {
    if (!scanner) return;
    const octo::Snapshot snap = registry.snapshot(lp->now(), clock.wall());
    // Heard lately, not heard right now. A box at the edge of range is stale
    // between advertisements and was therefore almost never live at the
    // moment this ran, so it never got asked its name -- see src/naming.h.
    int unnamed = 0;
    for (const octo::DeviceSnapshot& d : snap.device) {
      if (!octo::is_placeholder_name(d.name)) continue;
      if (d.heard_this_run && d.age <= octo::kNameWithin) ++unnamed;
    }
    static bool active = false;
    static double changed_at = 0.0;
    const bool want =
        octo::want_active_scan(active, unnamed, lp->now() - changed_at);
    if (want == active) return;
    active = want;
    changed_at = lp->now();
    scanner->set_active(active);
  });

  if (g_led.port != nullptr) {
    gpio_pin_configure_dt(&g_led, GPIO_OUTPUT_INACTIVE);
    // Idle is an even flash; attached is lit with a short wink in it. Two
    // states that look different across the room, which is the whole job: the
    // questions a person standing over the dongle has are "is it running" and
    // "did the Mac find it", and there is no console to answer either.
    loop->every(0.25, [&peer]() {
      static int tick = 0;
      ++tick;
      const int period = peer.attached() ? 8 : 4;
      const int phase = tick % period;
      const bool lit = peer.attached() ? phase != 0 : phase < 2;
      gpio_pin_set_dt(&g_led, lit ? 1 : 0);
    });
  }

  loop->run();
  return 0;
}
```

## src/blepeer.cc
```c
// See firmware/src/blepeer.h.
#include "blepeer.h"

#include <zephyr/bluetooth/bluetooth.h>
#include <zephyr/bluetooth/conn.h>
#include <zephyr/bluetooth/gatt.h>
#include <zephyr/bluetooth/uuid.h>
#include <zephyr/sys/util.h>

#include <vector>

// Nordic's UART Service. See the header for why these rather than a private
// set: it is the one "bytes in, bytes out" GATT service every generic
// Bluetooth tool already knows how to open, and this device has no other way
// of being looked at.
//
// BT_UUID_128_ENCODE rather than a hand-written byte list, because a 128-bit
// UUID goes on the wire least-significant byte first and writing that out by
// hand is the kind of mistake that produces a service nothing can find and no
// error anywhere.
#define OCTO_NUS_SVC_VAL \
  BT_UUID_128_ENCODE(0x6E400001, 0xB5A3, 0xF393, 0xE0A9, 0xE50E24DCCA9E)
#define OCTO_NUS_RX_VAL \
  BT_UUID_128_ENCODE(0x6E400002, 0xB5A3, 0xF393, 0xE0A9, 0xE50E24DCCA9E)
#define OCTO_NUS_TX_VAL \
  BT_UUID_128_ENCODE(0x6E400003, 0xB5A3, 0xF393, 0xE0A9, 0xE50E24DCCA9E)

static struct bt_uuid_128 octo_nus_svc = BT_UUID_INIT_128(OCTO_NUS_SVC_VAL);
// RX is what the *central* writes to; TX is what the box notifies on. The
// names are from the central's point of view, which is Nordic's convention and
// worth keeping even though it reads backwards from in here.
static struct bt_uuid_128 octo_nus_rx = BT_UUID_INIT_128(OCTO_NUS_RX_VAL);
static struct bt_uuid_128 octo_nus_tx = BT_UUID_INIT_128(OCTO_NUS_TX_VAL);

// The one peer, because the table below is a static definition with C
// callbacks and there is nowhere in it to put a `this`. Exactly one BlePeer
// ever exists -- there is one radio -- so a file-scope pointer is the honest
// spelling rather than a limitation being worked around.
static octo::BlePeer* g_ble_peer = nullptr;

static ssize_t octo_nus_write(struct bt_conn* conn,
                              const struct bt_gatt_attr* attr, const void* buf,
                              uint16_t len, uint16_t offset, uint8_t flags) {
  ARG_UNUSED(conn);
  ARG_UNUSED(attr);
  ARG_UNUSED(flags);
  // A long write arrives in pieces with a growing offset. Reassembling it here
  // would mean a buffer per connection for no gain -- the protocol is lines,
  // and a line too long for one write can simply arrive as two. So the offset
  // is ignored and the bytes are appended in the order they came, which is the
  // order they were sent.
  ARG_UNUSED(offset);
  if (g_ble_peer != nullptr) {
    g_ble_peer->on_written(static_cast<const uint8_t*>(buf), len);
  }
  return len;
}

static void octo_nus_ccc(const struct bt_gatt_attr* attr, uint16_t value) {
  ARG_UNUSED(attr);
  if (g_ble_peer != nullptr) {
    g_ble_peer->on_subscribed(value == BT_GATT_CCC_NOTIFY);
  }
}

BT_GATT_SERVICE_DEFINE(
    octo_nus, BT_GATT_PRIMARY_SERVICE(&octo_nus_svc),
    BT_GATT_CHARACTERISTIC(&octo_nus_tx.uuid, BT_GATT_CHRC_NOTIFY,
                           BT_GATT_PERM_NONE, NULL, NULL, NULL),
    BT_GATT_CCC(octo_nus_ccc, BT_GATT_PERM_READ | BT_GATT_PERM_WRITE),
    BT_GATT_CHARACTERISTIC(&octo_nus_rx.uuid,
                           BT_GATT_CHRC_WRITE | BT_GATT_CHRC_WRITE_WITHOUT_RESP,
                           BT_GATT_PERM_WRITE, NULL, octo_nus_write, NULL));

// Attribute 2 is the TX characteristic's *value*, which is what a notification
// goes on -- attribute 1 is its declaration. Named, because getting it wrong
// notifies the wrong attribute and fails quietly.
static const int kTxValueAttr = 2;

static void octo_connected(struct bt_conn* conn, uint8_t err) {
  if (err != 0) return;
  if (g_ble_peer != nullptr) g_ble_peer->on_connected(bt_conn_ref(conn));
}

static void octo_disconnected(struct bt_conn* conn, uint8_t reason) {
  ARG_UNUSED(conn);
  ARG_UNUSED(reason);
  if (g_ble_peer != nullptr) g_ble_peer->on_disconnected();
}

BT_CONN_CB_DEFINE(octo_conn_cb) = {
    .connected = octo_connected,
    .disconnected = octo_disconnected,
};

// Connectable and named. The name is all a person scanning with a phone has to
// go on, and CONFIG_BT_DEVICE_NAME is where it comes from.
static const struct bt_data kAdvert[] = {
    BT_DATA_BYTES(BT_DATA_FLAGS, BT_LE_AD_GENERAL | BT_LE_AD_NO_BREDR),
    BT_DATA(BT_DATA_NAME_COMPLETE, CONFIG_BT_DEVICE_NAME,
            sizeof(CONFIG_BT_DEVICE_NAME) - 1),
};

// The service UUID goes in the scan response rather than the advertisement. A
// 128-bit UUID is sixteen bytes and the name takes most of what is left of the
// legacy thirty-one; putting both in one packet leaves room for neither.
static const struct bt_data kScanResponse[] = {
    BT_DATA_BYTES(BT_DATA_UUID128_ALL, OCTO_NUS_SVC_VAL),
};

namespace octo {

BlePeer::BlePeer(Loop* loop) : loop_(loop) {
  k_poll_signal_init(&rx_signal_);
  ring_buf_init(&rx_, sizeof rx_storage_, rx_storage_);
  g_ble_peer = this;
}

BlePeer::~BlePeer() {
  stop();
  if (g_ble_peer == this) g_ble_peer = nullptr;
}

bool BlePeer::start(std::string* err) {
  if (started_) return true;

  Handle handle;
  handle.object = &rx_signal_;
  source_ = loop_->add_source(
      handle, kRead, [this](int) { drain(); }, [](const std::string&) {});

  started_ = true;
  advertise();
  if (!advertising_) {
    if (err != nullptr) *err = "the radio would not advertise";
    stop();
    return false;
  }
  return true;
}

void BlePeer::stop() {
  if (!started_) return;
  if (advertising_) {
    bt_le_adv_stop();
    advertising_ = false;
  }
  if (source_ != kNoSource) loop_->remove_source(source_);
  source_ = kNoSource;
  started_ = false;
}

void BlePeer::advertise() {
  if (advertising_ || !started_ || connected_) return;
  // Fast rather than the slow default: this is a device somebody is trying to
  // reach on purpose, not a beacon, and seconds spent waiting for it to become
  // discoverable are seconds spent wondering whether the firmware is running
  // at all -- which, on a box with no console, is not a cheap doubt.
  const int rc =
      bt_le_adv_start(BT_LE_ADV_CONN_FAST_1, kAdvert, ARRAY_SIZE(kAdvert),
                      kScanResponse, ARRAY_SIZE(kScanResponse));
  advertising_ = rc == 0;
}

// ---------------------------------------------------- Bluetooth's thread

void BlePeer::on_written(const uint8_t* data, uint16_t len) {
  if (len == 0) return;
  const uint32_t put = ring_buf_put(&rx_, data, len);
  if (put < len) dropped_rx_ += len - put;
  // Idempotent: a signal already raised stays raised, so a burst of writes is
  // one wake rather than a queue of them.
  k_poll_signal_raise(&rx_signal_, 1);
}

void BlePeer::on_connected(struct bt_conn* conn) {
  // The reference is taken by the caller and released by the loop, not here.
  // See settle(): the loop needs the connection to ask what the MTU is, and
  // dropping the last reference on this thread would free it out from under a
  // send() that had already started.
  conn_ = conn;
  connected_ = true;
  ++sessions_;
  advertising_ = false;  // the controller stops advertising on connect
  k_poll_signal_raise(&rx_signal_, 1);
}

void BlePeer::on_disconnected() {
  connected_ = false;
  notify_on_ = false;
  k_poll_signal_raise(&rx_signal_, 1);
}

void BlePeer::on_subscribed(bool on) {
  notify_on_ = on;
  k_poll_signal_raise(&rx_signal_, 1);
}

// ---------------------------------------------------------- loop thread

void BlePeer::drain() {
  settle();

  for (;;) {
    uint8_t buf[128];
    const uint32_t got = ring_buf_get(&rx_, buf, sizeof buf);
    if (got == 0) break;
    std::vector<std::string> lines;
    if (!reader_.feed(reinterpret_cast<const char*>(buf), got, &lines)) {
      ++long_lines_;
    }
    for (const std::string& line : lines) {
      if (on_line_) on_line_(line);
    }
  }
}

// A central that has connected but not subscribed cannot be talked to, so it
// is not a peer yet. Treating it as one would send the greeting into a
// notification nobody had enabled, and the daemon would then believe it had
// introduced itself -- and never do it again.
void BlePeer::settle() {
  const bool ready = connected_ && notify_on_;
  if (ready != attached_) {
    attached_ = ready;
    if (attached_) {
      reader_.reset();
      if (on_open_) on_open_();
    } else if (on_close_) {
      on_close_();
    }
  }

  if (!connected_) {
    // The reference the connection callback took, released here rather than
    // there so that a send() already running on this thread cannot be left
    // holding a freed connection.
    if (conn_ != nullptr) {
      bt_conn_unref(conn_);
      conn_ = nullptr;
    }
    // The controller stopped advertising when it accepted the connection, so
    // without this the box is unreachable until somebody power-cycles it.
    advertise();
  }
}

void BlePeer::send(const std::string& line) {
  if (!attached_) {
    ++dropped_tx_;
    return;
  }
  std::string out = line;
  out += '\n';

  // A notification carries at most the MTU minus three bytes of ATT header,
  // and the MTU is whatever the central agreed to -- 23 until it asks for
  // more, which leaves twenty bytes. So a line is split, and the far end puts
  // it back together with the same LineReader the cable uses: a notification
  // is not a message boundary, any more than a serial read is.
  size_t chunk = 20;
  if (conn_ != nullptr) {
    const uint16_t mtu = bt_gatt_get_mtu(conn_);
    if (mtu > 3) chunk = static_cast<size_t>(mtu - 3);
  }

  for (size_t at = 0; at < out.size(); at += chunk) {
    const size_t n = out.size() - at < chunk ? out.size() - at : chunk;
    // A null connection means "everyone who subscribed", which with one
    // connection allowed is the same thing and saves reasoning about the
    // reference here.
    const int rc = bt_gatt_notify(nullptr, &octo_nus.attrs[kTxValueAttr],
                                  out.data() + at, static_cast<uint16_t>(n));
    if (rc != 0) {
      // Out of buffers, or the link went while we were writing. Counted and
      // abandoned rather than queued: an announcement is a perishable
      // statement about the present, and there is nowhere on this device to
      // keep one that has gone stale.
      //
      // The far end sees a truncated line, which its LineReader will fail to
      // decode and count as a bad line. That is the right outcome -- a
      // half-message must not be acted on -- and it is why both ends count
      // what they could not read.
      ++dropped_tx_;
      return;
    }
  }
}

}  // namespace octo
```

## src/blepeer.h
```c
// The box protocol over a BLE characteristic, on the loop.
//
// The third of the three transports src/boxsock.h names: "a unix socket when
// the sync daemon is a process on this Mac, a USB CDC serial port when it is
// a Nordic on the end of a cable, and a BLE characteristic when that Nordic is
// powered from something else". This is the last one, and it is what makes a
// dongle in a phone charger a usable member of the system rather than a thing
// that has to stay tethered to a laptop.
//
// It is a peer like any other. src/syncd.h keeps a list of them and announces
// to all of them, so a box with a cable *and* a radio link simply has two, and
// nothing here has to decide which is in charge. That decision belongs to the
// host -- see want_bluetooth() and carrier() in src/dongle.h -- because the
// host is the end that knows whether it also has a cable. A box that tried to
// arbitrate would have to guess at facts only the other end can see.
//
// **The UUIDs are Nordic's UART Service, on purpose.** Not because anything
// here is a UART, but because NUS is the one well-known "bytes in, bytes out"
// GATT service, and every generic Bluetooth tool on every phone can open it
// and type into it. This device has no console and no screen; its failures
// have twice now been invisible for a day. Being openable by software nobody
// had to write first is worth more than a private UUID would buy. What travels
// over it is exactly what travels over the cable: one line per message.
//
// **Nothing here parses.** Bytes arrive on Bluetooth's own thread and are put
// in a ring buffer; a signal wakes the loop, and the loop does the rest. That
// is the same arrangement as firmware/src/cdcpeer.h and for the same reason:
// the registry, the daemon and every handler run on one thread, and the whole
// design in src/loop.h depends on that staying true.
#ifndef OCTO_FW_BLEPEER_H
#define OCTO_FW_BLEPEER_H

#include <zephyr/kernel.h>
#include <zephyr/sys/ring_buffer.h>

struct bt_conn;

#include <cstdint>
#include <functional>
#include <string>

#include "boxmsg.h"
#include "loop.h"
#include "syncd.h"

namespace octo {

class BlePeer : public MsgPeer {
 public:
  explicit BlePeer(Loop* loop);
  ~BlePeer();

  BlePeer(const BlePeer&) = delete;
  BlePeer& operator=(const BlePeer&) = delete;

  using LineHandler = std::function<void(const std::string& line)>;
  using OpenHandler = std::function<void()>;
  using CloseHandler = std::function<void()>;

  // All called on the loop's thread, never from Bluetooth's.
  void on_line(LineHandler h) { on_line_ = std::move(h); }
  void on_open(OpenHandler h) { on_open_ = std::move(h); }
  void on_close(CloseHandler h) { on_close_ = std::move(h); }

  // Begins advertising. bt_enable() must have completed first.
  bool start(std::string* err);
  void stop();

  // MsgPeer. Appends the newline, and splits the result across as many
  // notifications as the negotiated MTU requires -- a GATT notification is not
  // a message boundary any more than a serial read is, which is exactly why
  // LineReader exists at both ends.
  void send(const std::string& line) override;

  // Whether a central is connected and listening. False while advertising:
  // a box nobody has connected to is working correctly.
  bool attached() const { return attached_; }
  // Connections accepted since boot. A central that keeps reconnecting is a
  // different problem from one that never arrives, and this is what tells
  // them apart on a device with no log.
  uint32_t sessions() const { return sessions_; }

  // Notifications that would not fit or would not go. Cumulative and never
  // reset: the question is "has this ever happened", not "is it happening
  // now". A radio link drops where a cable does not, so this one is expected
  // to be nonzero on a busy box and is not by itself a fault.
  uint32_t dropped_tx() const { return dropped_tx_; }
  uint32_t dropped_rx() const { return dropped_rx_; }
  uint32_t long_lines() const { return long_lines_; }

  // Bluetooth's thread calls these. Public only because the GATT and
  // connection callbacks are C functions; nothing else should.
  void on_written(const uint8_t* data, uint16_t len);
  // Takes ownership of a reference; it is released on the loop's thread.
  void on_connected(struct bt_conn* conn);
  void on_disconnected();
  void on_subscribed(bool on);

 private:
  void drain();          // loop thread: ring buffer -> LineReader -> on_line_
  void settle();         // loop thread: act on a connection change
  void advertise();

  Loop* loop_ = nullptr;

  // Raised by Bluetooth's thread, waited on by the loop. See
  // firmware/src/loop_zephyr.cc: this is the only thing another thread is
  // allowed to do to the loop.
  struct k_poll_signal rx_signal_;
  SourceId source_ = kNoSource;

  struct ring_buf rx_;
  // Smaller than the cable's. A central writes a command and waits; nothing
  // streams into this the way a host can stream into a serial port.
  uint8_t rx_storage_[512];

  LineReader reader_;
  LineHandler on_line_;
  OpenHandler on_open_;
  CloseHandler on_close_;

  bool started_ = false;
  bool attached_ = false;
  bool advertising_ = false;

  // Written by Bluetooth's thread, read by the loop. Aligned words on a
  // Cortex-M, so a torn read is not possible and a lock would buy nothing --
  // and could not exist anyway: this SDK's libstdc++ has no std::mutex. See
  // src/loop.h.
  // Held from the connection callback until the loop notices the
  // disconnection, so that a send() in progress cannot be left holding a
  // connection that Bluetooth's thread has already freed.
  struct bt_conn* conn_ = nullptr;
  volatile bool connected_ = false;
  volatile bool notify_on_ = false;
  volatile uint32_t sessions_ = 0;
  volatile uint32_t dropped_tx_ = 0;
  volatile uint32_t dropped_rx_ = 0;
  volatile uint32_t long_lines_ = 0;
};

}  // namespace octo

#endif  // OCTO_FW_BLEPEER_H
```

## src/boxadmin.cc
```c
// See firmware/src/boxadmin.h.
#include "boxadmin.h"

#include <hal/nrf_power.h>
#include <zephyr/kernel.h>
#include <zephyr/sys/reboot.h>

#include "boxmsg.h"
#include "faultlog.h"
#include "scanner_zephyr.h"

namespace octo {
namespace {

}  // namespace

bool handle_box_admin(const std::string& line, MsgPeer* peer,
                      const PeerStats& stats) {
  Message msg;
  std::string err;
  if (!decode(line, &msg, &err)) return false;  // the daemon reports bad lines

  if (msg.verb == "boxstats") {
    Message out;
    out.verb = "boxstats";
    if (msg.has("id")) out.set("id", msg.get("id"));
    // Everything that can be dropped, and was. All cumulative: the question a
    // person asks is "has this ever happened", not "is it happening now".
    out.set_int("adverts_dropped", zephyr_scanner_dropped());
    out.set_int("tx_dropped", stats.dropped_tx);
    out.set_int("rx_dropped", stats.dropped_rx);
    out.set_int("long_lines", stats.long_lines);
    // Whether this build can print the numbers it is being asked for. If this
    // is 0 then every other figure in this message is an integer that happened
    // to survive, and every double the box has sent is empty.
    out.set_bool("floats", can_format_doubles());
    // Free heap is not reported. There is no supported way to ask picolibc's
    // arena how much of it is left, and a figure invented here would be worse
    // than the silence -- it is exactly the kind of number that gets believed.
    peer->send(encode(out));
    return true;
  }

  if (msg.verb == "dfu") {
    // Confirmation required. This is the one command that ends the
    // conversation, and a client retrying a garbled line should not be able to
    // take the radio off the air by accident.
    bool confirm = false;
    if (!msg.get_bool("confirm", &confirm) || !confirm) {
      Message bad;
      bad.verb = "err";
      if (msg.has("id")) bad.set("id", msg.get("id"));
      bad.set("reason", "needs-confirm");
      bad.set("hint", "dfu confirm=1");
      peer->send(encode(bad));
      return true;
    }

    Message out;
    out.verb = "ok";
    if (msg.has("id")) out.set("id", msg.get("id"));
    out.set("what", "dfu");
    peer->send(encode(out));

    // Let the reply reach the host before the USB device disappears. There is
    // no way to ask the CDC ring whether the endpoint has drained, and a
    // reboot that beats the acknowledgement out of the door looks exactly like
    // a crash. A tenth of a second is far longer than a bulk transfer and far
    // shorter than a person's patience.
    k_sleep(K_MSEC(100));

    // A person replacing the image is a person saying the old one's troubles
    // are over. Without this, a box that failed its way into safe mode stays
    // in safe mode across the reflash that was meant to fix it -- the count
    // lives in memory that a soft reset does not clear -- and the only way out
    // is a power cycle, which is the trip to the desk this whole mechanism
    // exists to avoid.
    forget_boot_failures();
    enter_bootloader();
    return true;  // not reached
  }

  return false;
}

}  // namespace octo
```
